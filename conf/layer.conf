## conf/layer.conf
```bitbake
# We have a conf and classes directory, add to BBPATH
BBPATH .= ":${LAYERDIR}"

# We have a recipes-* directories, add to BBFILES
BBFILES += "${LAYERDIR}/recipes-*/*/*.bb \
	${LAYERDIR}/recipes-*/*/*.bbappend"

BBFILE_COLLECTIONS += "amlogic"
BBFILE_PATTERN_amlogic = "^${LAYERDIR}/"
BBFILE_PRIORITY_amlogic = "6"
```

## conf/machine/include/amlogic-m6-default-versions.inc
```bitbake
# Amlogic BSP default versions

PREFERRED_VERSION_linux-amlogic ?= "3.10.54%"
#PREFERRED_VERSION_opengl-amlogic ?= "20.%"
PERFERRED_VERSION_opengl-amlogic ?= "401.0.hf"
```

## conf/machine/wetekplay.conf
```bitbake
#@TYPE: Machine
#@NAME: wetekplay

#@DESCRIPTION: Machine configuration for wetekplay systems

# Amlogic defaults
require conf/machine/include/amlogic.inc

# Ship all kernel modules by default
MACHINE_EXTRA_RRECOMMENDS += " kernel-modules \
                               wetek-dvb-modules \
"
MACHINE_ESSENTIAL_EXTRA_RDEPENDS += " firmware-ap6210 wetek-dvb-modules  "

# Uncomment the following line to enable the hard floating point abi. Note that
# this breaks some binary libraries and 3D (neither of which ship with
# meta-yocto). For maximum compatibility, leave this disabled.
DEFAULTTUNE ?= "cortexa9hf-neon"
include conf/machine/include/tune-cortexa9.inc

IMAGE_FSTYPES += "tar.bz2 ext4 wetek-sdimg"

# Serial console to be used
SERIAL_CONSOLE = "115200 ttyS0"

PREFERRED_PROVIDER_virtual/kernel ?= "linux-amlogic"
PREFERRED_VERSION_linux-libc-headers = "3.10"

#INITRAMFS_IMAGE = "amlogic-initramfs"
#INITRAMFS_IMAGE_BUNDLE = "1"

KERNEL_IMAGETYPE = "uImage-dtb"
KERNEL_DEVICETREE = "wetekplay.dtd"

UBOOT_ENTRYPOINT  = "0x80008000"
UBOOT_LOADADDRESS = "0x80008000"

MACHINE_FEATURES = "bluetooth usbhost vfat alsa"
```
